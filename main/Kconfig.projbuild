## main/Kconfig.projbuild
```kconfig
menu "USB/IP Bridge Configuration"

choice USBIP_TRANSPORT
    prompt "Network transport"
    default USBIP_TRANSPORT_ETHERNET if IDF_TARGET_ESP32P4
    default USBIP_TRANSPORT_WIFI if IDF_TARGET_ESP32S3
    default USBIP_TRANSPORT_ETHERNET

    config USBIP_TRANSPORT_ETHERNET
        bool "Ethernet"
        depends on IDF_TARGET_ESP32P4
    config USBIP_TRANSPORT_WIFI
        bool "Wi-Fi STA"
        depends on IDF_TARGET_ESP32S3
endchoice

if USBIP_TRANSPORT_ETHERNET

config USBIP_ETH_MDC_GPIO
    int "Ethernet MDC GPIO"
    default 31

config USBIP_ETH_MDIO_GPIO
    int "Ethernet MDIO GPIO"
    default 52

config USBIP_ETH_PHY_ADDR
    int "Ethernet PHY address"
    range 0 31
    default 1

config USBIP_ETH_PHY_RST_GPIO
    int "Ethernet PHY reset GPIO (-1 to disable)"
    default 51

endif

if USBIP_TRANSPORT_WIFI

config USBIP_WIFI_SSID
    string "Wi-Fi SSID"
    default ""

config USBIP_WIFI_PASSWORD
    string "Wi-Fi password"
    default ""

config USBIP_WIFI_MAX_RETRY
    int "Wi-Fi max retries"
    range 1 50
    default 10

config USBIP_WIFI_AUTHMODE
    int "Minimum AP auth mode (0=OPEN, 1=WPA, 2=WPA2, 3=WPA2/WPA3)"
    range 0 3
    default 3

config USBIP_WIFI_DISABLE_MODEM_SLEEP
    bool "Disable Wi-Fi modem sleep (WIFI_PS_NONE)"
    default y
    help
        Keeps Wi-Fi radio fully active after association. This increases power
        usage but improves latency and avoids Wi-Fi power-save side effects
        during USB host bridging.

endif

if IDF_TARGET_ESP32S3

config USBIP_S3_USB_OTG_DEVKIT_POWER
    bool "Enable ESP32-S3-USB-OTG board power GPIO setup"
    default y
    help
        Configure the onboard power routing GPIOs used by the ESP32-S3-USB-OTG
        board to provide VBUS in host mode.

config USBIP_S3_USB_BOOST_EN_GPIO
    int "S3 USB OTG BOOST_EN GPIO"
    default 13
    depends on USBIP_S3_USB_OTG_DEVKIT_POWER

config USBIP_S3_USB_DEV_VBUS_EN_GPIO
    int "S3 USB OTG DEV_VBUS_EN GPIO"
    default 12
    depends on USBIP_S3_USB_OTG_DEVKIT_POWER

config USBIP_S3_USB_LIMIT_EN_GPIO
    int "S3 USB OTG LIMIT_EN GPIO"
    default 17
    depends on USBIP_S3_USB_OTG_DEVKIT_POWER

config USBIP_S3_USB_SEL_GPIO
    int "S3 USB OTG USB_SEL GPIO"
    default 18
    depends on USBIP_S3_USB_OTG_DEVKIT_POWER

endif

config USBIP_SERVER_TASK_STACK
    int "USB/IP server task stack (bytes)"
    default 8192

config USBIP_SERVER_TASK_PRIORITY
    int "USB/IP server task priority"
    default 8

config USBIP_MAX_TRANSFER
    int "Maximum transfer payload size"
    range 64 16384
    default 4096

config USBIP_MAX_DEVICES
    int "Maximum exported USB devices"
    range 1 16
    default 8
    help
        Maximum number of simultaneously exported non-hub USB devices.
        Increase this when using downstream hubs with multiple peripherals.

config USBIP_NUM_PIPES
    int "Number of USB host pipe request slots"
    default 16 if IDF_TARGET_ESP32P4
    default 8
    help
        Number of concurrent USB transfer request slots.  Should match the
        DWC host controller channel count (16 for ESP32-P4, 8 for ESP32-S3).

endmenu

menu "Virtual Logic Capture Configuration"

    config USBIP_VIRTUAL_LOGIC_ANALYZER
        bool "Enable virtual logic analyzer"
        default y
        help
            Expose a virtual USB device that streams logic-capture data
            via Perfetto trace format over a CDC-ACM interface.

    config LOGIC_CAPTURE_SAMPLE_RATE_HZ
        int "Sample rate (Hz)"
        default 1000000
        depends on USBIP_VIRTUAL_LOGIC_ANALYZER

    config LOGIC_CAPTURE_GPIO_D0
        int "Channel 0 GPIO"
        default 10
        depends on USBIP_VIRTUAL_LOGIC_ANALYZER

    config LOGIC_CAPTURE_GPIO_D1
        int "Channel 1 GPIO"
        default 11
        depends on USBIP_VIRTUAL_LOGIC_ANALYZER

    config LOGIC_CAPTURE_GPIO_D2
        int "Channel 2 GPIO"
        default 12
        depends on USBIP_VIRTUAL_LOGIC_ANALYZER

    config LOGIC_CAPTURE_GPIO_D3
        int "Channel 3 GPIO"
        default 13
        depends on USBIP_VIRTUAL_LOGIC_ANALYZER

    config LOGIC_CAPTURE_GPIO_D4
        int "Channel 4 GPIO"
        default -1
        depends on USBIP_VIRTUAL_LOGIC_ANALYZER

    config LOGIC_CAPTURE_GPIO_D5
        int "Channel 5 GPIO"
        default -1
        depends on USBIP_VIRTUAL_LOGIC_ANALYZER

    config LOGIC_CAPTURE_GPIO_D6
        int "Channel 6 GPIO"
        default -1
        depends on USBIP_VIRTUAL_LOGIC_ANALYZER

    config LOGIC_CAPTURE_GPIO_D7
        int "Channel 7 GPIO"
        default -1
        depends on USBIP_VIRTUAL_LOGIC_ANALYZER

    config LOGIC_CAPTURE_ENABLE_GPIO
        int "Enable/valid input GPIO (-1 to disable)"
        default -1
        depends on USBIP_VIRTUAL_LOGIC_ANALYZER

    config LOGIC_CAPTURE_ENABLE_ACTIVE_LOW
        bool "Enable pin is active-low"
        default n
        depends on LOGIC_CAPTURE_ENABLE_GPIO != -1

endmenu

menu "Virtual Test Harness Configuration"

    config USBIP_VIRTUAL_HARNESS
        bool "Enable virtual test harness"
        default y
        help
            Expose a virtual USB CDC-ACM device that runs the esp-harness
            SCPI test harness internally.  The device accepts SCPI commands
            from a USB/IP host to drive GPIO, I2C, SPI, and UART buses on
            the bridge MCU.

endmenu
```

## sdkconfig.defaults
```kconfig
# Common defaults for USB/IP bridge
CONFIG_USBIP_SERVER_TASK_STACK=8192
CONFIG_USBIP_SERVER_TASK_PRIORITY=8
CONFIG_USBIP_MAX_TRANSFER=4096

# Always use UART0 for console output.
CONFIG_ESP_CONSOLE_UART_DEFAULT=y
CONFIG_ESP_CONSOLE_UART_NUM=0
CONFIG_ESP_CONSOLE_SECONDARY_NONE=y

# ESP32-P4 minimum chip revision v1.0 (mutually exclusive with v3.x)
CONFIG_ESP32P4_SELECTS_REV_LESS_V3=y
CONFIG_ESP32P4_REV_MIN_100=y

# Enable USB host external hub support (single tier only to conserve
# DWC HCD channels — multi-level hubs consume too many of the 8 available).
CONFIG_USB_HOST_HUBS_SUPPORTED=y
CONFIG_USB_HOST_HUB_MULTI_LEVEL=n
```

## sdkconfig.defaults.m5stack-poe-p4
```kconfig
CONFIG_IDF_TARGET="esp32p4"
CONFIG_USBIP_TRANSPORT_ETHERNET=y

# Use UART0 for console; USB Serial/JTAG available as secondary.
CONFIG_ESP_CONSOLE_UART_DEFAULT=y
CONFIG_ESP_CONSOLE_SECONDARY_USB_SERIAL_JTAG=y

# M5Stack Unit PoE-P4 Ethernet RMII defaults (same as P4-Function-EV)
CONFIG_USBIP_ETH_MDC_GPIO=31
CONFIG_USBIP_ETH_MDIO_GPIO=52
CONFIG_USBIP_ETH_PHY_ADDR=1
CONFIG_USBIP_ETH_PHY_RST_GPIO=51
```

## sdkconfig.defaults.p4-function-ev
```kconfig
CONFIG_IDF_TARGET="esp32p4"
CONFIG_USBIP_TRANSPORT_ETHERNET=y

# On P4, USB Serial/JTAG console does not conflict with USB host mode.
# CONFIG_ESP_CONSOLE_UART_DEFAULT is not set
CONFIG_ESP_CONSOLE_USB_SERIAL_JTAG=y

# ESP32-P4-Function-EV Ethernet RMII defaults
CONFIG_USBIP_ETH_MDC_GPIO=31
CONFIG_USBIP_ETH_MDIO_GPIO=52
CONFIG_USBIP_ETH_PHY_ADDR=1
CONFIG_USBIP_ETH_PHY_RST_GPIO=51
```

## sdkconfig.defaults.s3-usb-otg
```kconfig
CONFIG_IDF_TARGET="esp32s3"
CONFIG_USBIP_TRANSPORT_WIFI=y

# Set these for your Wi-Fi network before flashing.
CONFIG_USBIP_WIFI_SSID="circuitwifi2.4"
CONFIG_USBIP_WIFI_PASSWORD="circuitpython"
CONFIG_USBIP_WIFI_MAX_RETRY=8
CONFIG_USBIP_WIFI_AUTHMODE=2

# ESP32-S3-USB-OTG board host-power control GPIO defaults
CONFIG_USBIP_S3_USB_OTG_DEVKIT_POWER=y
CONFIG_USBIP_S3_USB_BOOST_EN_GPIO=13
CONFIG_USBIP_S3_USB_DEV_VBUS_EN_GPIO=12
CONFIG_USBIP_S3_USB_LIMIT_EN_GPIO=17
CONFIG_USBIP_S3_USB_SEL_GPIO=18

# Disable virtual logic analyzer on this board
# CONFIG_USBIP_VIRTUAL_LOGIC_ANALYZER is not set
```
